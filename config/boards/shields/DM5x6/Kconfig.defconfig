## config/boards/shields/DM5x6/Kconfig.defconfig
```kconfig
kconfig.defconfig

if SHIELD_DM5X6_LEFT

    config ZMK_KEYBOARD_NAME
        default "Dactyl(L)"

    config ZMK_SPLIT_BLE_ROLE_CENTRAL
        default y

endif

if SHIELD_DM5X6_RIGHT

    config ZMK_KEYBOARD_NAME
        default "Dactyl(R)"

endif

if SHIELD_DM5X6_LEFT || SHIELD_DM5X6_RIGHT

    config ZMK_SPLIT
        default y

endif
```

## config/boards/shields/DM5x6/Kconfig.shield
```kconfig
config SHIELD_DM5X6_LEFT
    def_bool $(shields_list_contains, DM5x6_left)

config SHIELD_DM5X6_RIGHT
    def_bool $(shields_list_contains, DM5x6_right)
```
